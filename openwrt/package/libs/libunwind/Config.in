## package/allwinner/eyesee-mpp/middleware/machinfo/v821/Config.in
```kconfig
config PACKAGE_eyesee-mpp-middleware_config
	bool "eyesee-mpp-middleware config"
	default y
	select PACKAGE_eyesee-mpp-middleware
	help
	  move config out of PACKAGE_eyesee-mpp-middleware to solve recursive dependency.

if PACKAGE_eyesee-mpp-middleware_config

config mpp_for_aw1931
	bool "select aw1931"
	default y
	help
	  mpp middleware for aw1931.

config mpp_support_fastboot
	bool "support fastboot"
	default n
	select libisp_support_fastboot
	help
	  mpp middleware support fastboot.

choice
	prompt "select log level for compile"
	default mpp_log_level_debug
config mpp_log_level_close
	bool "close"
	help
	  close log.
config mpp_log_level_error
	bool "error"
	help
	  compile error message.
config mpp_log_level_warn
	bool "warn"
	help
	  compile warning/error message.
config mpp_log_level_debug
	bool "debug"
	help
	  compile debug/warning/error message.
config mpp_log_level_verbose
	bool "verbose"
	help
	  compile verbose/debug/warning/error message.
endchoice

choice
	prompt "select fwrite method"
	default mpp_fwrite_method_vfs
	help
	  when writing file in recording, recorder can use vfs mode
	  or directIO mode. vfs mode is common and we recommend it,
	  directIO mode has its special advantage: don't use memory as
	  file buffer, so it is useful when system memory is very low,
	  but we don't recommend it unless there is no other solutions.

config mpp_fwrite_method_vfs
	bool "vfs"
	help
	  It is a common method, recommend it.

config mpp_fwrite_method_directIO
	bool "directIO"
	help
	  It can run in small memory, but do not recommend using this mode.
	  Be careful to select it.

endchoice

config mpp_hw_display
	bool "use hw display method"
	help
	  hw_display method is used to show video frame directly on hw layer.
	  It will bypass gpu.

config mpp_vi
	bool "enable vi component"
	help
	  vi(video input) captures csi frame.

config mpp_vo
	bool "enable vo component"
	help
	  vo(video output) is used to display video frame.

config mpp_textenc
	bool "enable textenc component"
	help
	  textenc is used to make subtitle when record video file.

config mpp_venc
	bool "enable venc component"
	depends on libcedarc_venc
	help
	  venc is used to encode video frame.

config mpp_venc_h264
	bool "support venc h264"
	depends on mpp_venc && libcedarc_venc_h264
	default y
	help
	  support video encode h264.

config mpp_venc_h265
	bool "support venc h265"
	depends on mpp_venc && libcedarc_venc_h265
	default y
	help
	  support video encode h265.

config mpp_venc_jpeg
	bool "support venc jpeg"
	depends on mpp_venc && libcedarc_venc_jpeg
	default y
	help
	  support video encode jpeg.

config mpp_vdec
	bool "enable vdec component"
	depends on libcedarc_vdec
	help
	  vdec is used to decode video frame.

config mpp_vdec_h264
	bool "support vdec h264"
	depends on mpp_vdec && libcedarc_vdec_h264
	default y
	help
	  support video decode h264.

config mpp_vdec_h265
	bool "support vdec h265"
	depends on mpp_vdec && libcedarc_vdec_h265
	default y
	help
	  support video decode h265.

config mpp_vdec_jpeg
	bool "support vdec jpeg"
	depends on mpp_vdec && libcedarc_vdec_jpeg
	default y
	help
	  support video decode jpeg.

config mpp_vdecsoft
	bool "enable vdecsoft component"
	help
	Enable VdecSoftlib.

config mpp_vdecsoft_h264
	bool "support vdecsoft h264"
	depends on mpp_vdecsoft
	default y
	help
	Enable H.264 decoding mode.

config mpp_aio
	bool "enable ai/ao component"
	default y
	help
	  ai(audio input) captures audio pcm data.
	  ao(audio output) play audio pcm data.

choice
	prompt "select specified library for aio"
	depends on mpp_aio
	default mpp_aio_alsa
	help
	  aio libraries are available,select one

	config mpp_aio_alsa
		bool "enable alsa library for aio"
		help
		  use alsa-lib from aio
	config mpp_aio_audiosystem
		bool "enable audiosystem library for aio"
		help
		  use audiosystem from aio
endchoice

config mpp_aenc
	bool "enable aenc component"
	default y
	help
	  aenc is used to encode audio frame.

config mpp_aenc_pcm
	bool "support aenc pcm"
	depends on mpp_aenc
	default y
	help
	  support encode pcm.

config mpp_aenc_g711
	bool "support aenc g711a/u"
	depends on mpp_aenc
	default n
	help
	  support encode g711a and g711u.

config mpp_aenc_g726
	bool "support aenc g726"
	depends on mpp_aenc
	default n
	help
	  support encode g726.

config mpp_aenc_aac
	bool "support aenc aac"
	depends on mpp_aenc
	default y
	help
	  support encode aac.

config mpp_aenc_mp3
	bool "support aenc mp3"
	depends on mpp_aenc
	default n
	help
	  support encode mp3.

config mpp_aenc_opus
	bool "support aenc opus"
	depends on mpp_aenc
	default n
	help
	  support encode opus.

config mpp_adec
	bool "enable adec component"
	default y
	help
	  adec is used to decode audio frame.

config mpp_adec_wav
	bool "support adec pcm,g711a/u"
	depends on mpp_adec
	default y
	help
	  support decode pcm,g711a/u.

config mpp_adec_g726
	bool "support adec g726a/u"
	depends on mpp_adec
	default n
	help
	  support decode g726a/u.

config mpp_adec_aac
	bool "support adec aac"
	depends on mpp_adec
	default y
	help
	  support decode aac

config mpp_adec_mp3
	bool "support adec mp3"
	depends on mpp_adec
	default n
	help
	  support decode mp3

config mpp_adec_amr
	bool "support adec amr"
	depends on mpp_adec
	default n
	help
	  support decode amr

config mpp_adec_ape
	bool "support adec ape"
	depends on mpp_adec
	default n
	help
	  support decode ape

config mpp_adec_flac
	bool "support adec flac"
	depends on mpp_adec
	default n
	help
	  support decode flac

config mpp_adec_ogg
	bool "support adec ogg-vorbis"
	depends on mpp_adec
	default n
	help
	  support decode vorbis

config mpp_adec_opus
	bool "support adec opus"
	depends on mpp_adec
	default n
	help
	  support decode opus

config mpp_muxer
	bool "enable muxer component"
	help
	  muxer is used to wrap video frame and audio frame.

choice
	prompt "select gps pack method in mp4 file"
	depends on mpp_muxer
	default mpp_gps_pack_in_mdat

	config mpp_gps_pack_in_track
		bool "pack in track"
		help
		  pack gps data in track of mp4 file, gps data is seen as a track.

	config mpp_gps_pack_in_mdat
		bool "pack in mdat"
		help
		  pack gps data in mdat of mp4 file.
endchoice

config mpp_demuxer
	bool "enable demuxer component"
	help
	  demuxer is used to demux video file to video stream, audio stream and subtitle stream.

config mpp_parser_aac
	bool "support parser aac"
	depends on mpp_demuxer
	default y
	help
	  support parser aac.
config mpp_parser_amr
	bool "support parser amr"
	depends on mpp_demuxer
	default n
	help
	  support parser amr.
config mpp_parser_ape
	bool "support parser ape"
	depends on mpp_demuxer
	default n
	help
	  support parser ape.
config mpp_parser_flac
	bool "support parser flac"
	depends on mpp_demuxer
	default n
	help
	  support parser flac.
config mpp_parser_id3v2
	bool "support parser id3v2"
	depends on mpp_demuxer
	default n
	help
	  support parser id3v2.
config mpp_parser_mov
	bool "support parser mov"
	depends on mpp_demuxer
	default y
	help
	  support parser mov.
config mpp_parser_mp3
	bool "support parser mp3"
	depends on mpp_demuxer
	select mpp_parser_id3v2
	default n
	help
	  support parser mp3.
config mpp_parser_mpg
	bool "support parser mpg"
	depends on mpp_demuxer
	default n
	help
	  support parser mpg.
config mpp_parser_ogg
	bool "support parser ogg"
	depends on mpp_demuxer
	default n
	help
	  support parser ogg.
config mpp_parser_ts
	bool "support parser ts"
	depends on mpp_demuxer
	default y
	help
	  support parser ts.
config mpp_parser_wav
	bool "support parser wav"
	depends on mpp_demuxer
	select mpp_parser_mp3
	default y
	help
	  support parser wav.

config mpp_stream_http
	bool "support stream http/https"
	depends on mpp_demuxer
	default n
	help
	  support stream http and https.
config mpp_stream_tcp
	bool "support stream tcp"
	depends on mpp_demuxer
	default n
	help
	  support stream tcp.

config mpp_aec
	bool "enable aec"
	help
	  aec is acoustic echo cancellation.
choice
	prompt "select specified aec library"
	depends on mpp_aec
	default mpp_aec_libwebrtc
	help
	  aec libraries are available,select one

	config mpp_aec_libwebrtc
		bool "enable aec library of webrtc"
		help
		  use aec libraty from webrtc
	config mpp_aec_libuvoice
		bool "enable aec library of uvoice"
		help
		  use aec libraty from uvoice
endchoice

config mpp_softdrc
	bool "enable soft drc"
	help
	  support soft drc.
config mpp_agc
	bool "enable agc"
	help
	  support agc.
choice
	prompt "select specified agc library"
	depends on mpp_agc
	default mpp_agc_libwebrtc
	help
	  agc libraries are available,select one

	config mpp_agc_libwebrtc
		bool "enable agc library of webrtc"
		help
		  use agc libraty from webrtc
	config mpp_agc_libagcfloat
		bool "enable agcfloat library"
		help
		  use agcfloat libraty
endchoice

#config mpp_ai_agc
#	bool "enable ai agc"
#	help
#	  support ai agc.

config mpp_ans
	bool "enable ans"
	help
	  ans is acoustic noise suppression.
choice
	prompt "select specified ans library"
	depends on mpp_ans
	default mpp_ans_libwebrtc
	help
	  two ans libraries are available,select one

	config mpp_ans_libwebrtc
		bool "enable ans library of webrtc"
		help
		  use ans libraty from webrtc
	config mpp_ans_liblstm
		bool "enable ans library of lstm"
		help
		  use ans library from lstm
	config mpp_ans_libnosc
		bool "enable ans library nosc"
		help
		  use ans library nosc
endchoice
config mpp_uvc
	bool "support usb video camera, enable uvc component"
	help
	  enable support for usb video camera.

choice
	prompt "select compile mpp as static/dynamic library"
	default mpp_compile_static_lib

config mpp_compile_static_lib
	bool "compile static lib"
	help
	  compile static lib of all capable modules.

config mpp_compile_dynamic_lib
	bool "compile dynamic lib"
	help
	  compile dynamic lib of all capable modules.
endchoice

config mpp_software_tdm_for_isp
	bool "software_tdm_for_isp"
	default n
	select libisp_software_tdm
	help
	  software_tdm_for_isp.

config mpp_systrace
	bool "use aw systrace to analyse"
	help
	  awsystrace will use ftrace to collect system running info.
	  It need to enable kernel ftrace first.

config mpp_filerepair
	bool "enable filerepair"
	default y
	help
	  repair damaged files.

config mpp_sample_configfileparser
	bool "select mpp sample configfileparser"
	default n
	help
	  parse conf file.

endif
```

## package/allwinner/llm/chatbox/volcengite/Config.in
```kconfig
config CHATBOX_VOLCENGITE_VISION
	bool "Enable Doubao vision capabilities"
	default n
	depends on PACKAGE_chatbox_volcengite
	help
		Enable Doubao vision features

config CHATBOX_VOLCENGITE_LOCAL_PREVIEW
	bool "Enable Doubao local preview function"
	default n
	depends on CHATBOX_VOLCENGITE_VISION
	help
		Enable Video local preview
```

## package/allwinner/llm/chatbox/xiaozhi/Config.in
```kconfig
config CHATBOX_XIAOZHI_DISPLAY
	bool "enable display"
	default n
	depends on PACKAGE_chatbox_xiaozhi
		help
		Whether use lvgl ui
```

## package/allwinner/multimedia/rt_media-mpp_demo/machinfo/v821/Config.in
```kconfig
config PACKAGE_rt_media-mpp_demo_config
	bool "rt_media-mpp_demo config"
	default n
	select PACKAGE_rt_media-mpp_demo
	help
	  move config out of PACKAGE_rt_media-mpp_demo to truely depend on other packages.

if PACKAGE_rt_media-mpp_demo_config

config rt_media-mpp_demo_avmuxer
	bool "demo_avmuxer"
	default y
	help
		use rt_media to get h265, use mpp-middleware to get aac.
		use mpp-middlware to wrap h265 and aac in mp4File.

config rt_media-mpp_demo_video_muxer
	bool "demo_video_muxer"
	default n
	help
		use rt_media to get h264, use mpi_mux to wrap to mp4 file.

config rt_media-mpp_demo_codec_parallel
	bool "demo_codec_parallel"
	default n
	select mpp_sample_configfileparser
	help
		use rt_media to vencoder, use mpi_vdec to vdecoder.

config rt_media-mpp_demo_video_rtsp
	bool "demo_video_rtsp"
	default n
	help
		use rt_media get encode stream send to rtsp.

config rt_media-mpp_demo_video_webrtc
	bool "demo_video_webrtc"
	default n
	select PACKAGE_libpeer
	select PACKAGE_wifimanager-v2.0-lib
	help
		use rt_media get encode stream send to web_rtc.

config demo_video_webrtc_autostart
	bool "Enable auto-start on boot"
	default n
	depends on rt_media-mpp_demo_video_webrtc
	help
		Enable this option if you want demo_video_webrtc to start automatically during boot.

config demo_video_webrtc_ai_lm
	bool "Enable ai_lm in demo_video_webrtc"
	default n
	depends on rt_media-mpp_demo_video_webrtc
	select PACKAGE_libailm
	help
		Enable this option if you want use ai_lm in demo_video_webrtc.

config rt_media-mpp_demo_avmuxer_photo
	bool "demo_avmuxer_photo"
	default n
	help
		use rt_media and mpp-middleware to demonstrate picture mode and record mode.

config rt_media-mpp_demo_timelapse
	bool "demo_timelapse"
	default n
	help
		show how to operate rt_media and mpi_mux to implement timelapse.

config rt_media-mpp_demo_mjpeg_dual_stream
	bool "demo_mjpeg_dual_stream"
	default n
	help
		show how to insert h264 stream to mjpeg APPn.

endif
```

## package/allwinner/multimedia/rt_media/machinfo/v821/Config.in
```kconfig
if PACKAGE_rt_media

config rt_media_venc_param_debug
	bool "support rt-media venc param debug"
	default n
	depends on PACKAGE_rt_media
	help
	  rt-media support rt-media venc param debug.

endif
```

## package/allwinner/multimedia/tina_multimedia/machinfo/v821/libcedarc/Config.in
```kconfig
menu "Select cedarc configuration options"
depends on PACKAGE_libcedarc

comment "V821 Video Encoders and Decoders options"

config libcedarc_venc
    bool "enable venc libs"
    default y
    help
      venc libs is used to encode video frame.

config libcedarc_venc_h264
    bool "support venc h264"
    depends on libcedarc_venc
    default y
    help
      support video encode h264.

config libcedarc_venc_jpeg
    bool "support venc jpeg"
    depends on libcedarc_venc
    default y
    help
      support video encode jpeg.

config libcedarc_venc_support_ext_param
    bool "support venc param parse of xml"
    depends on libcedarc_venc
    default y
    help
      venc debugging will use ext xml file to config venc params.

config libcedarc_vdec
    bool "enable vdec libs"
    default y
    help
      vdec is used to decode video frame.

config libcedarc_vdec_jpeg
    bool "support vdec jpeg"
    depends on libcedarc_vdec
    default y
    help
      support video decode jpeg.

config libcedarc_ion_size_pool_heap
    bool "use ion size pool heap"
    default y
    help
      use ion size pool heap.

choice
	prompt "select compile libcedarc to static or dynamic library"
	default libcedarc_compile_static_lib

config libcedarc_compile_static_lib
    bool "compile static lib"
    help
      compile static libs for libcedarc.

config libcedarc_compile_dynamic_lib
    bool "compile dynamic lib"
    help
      compile dynamic lib for libcedarc.

endchoice

config libcedarc_vencode_demo
    bool "compile vencode demo"
    default n
    help
      compile vencode demo of libcedarc.

endmenu
```

## package/allwinner/multimedia/tina_multimedia_demo/tplayerdemo/Config.in
```kconfig
menu "tplayerdemo extra functions support"
depends on PACKAGE_tplayerdemo

comment "TIPS: please disable PACKAGE_powerkey if process suspend-test while playing multi-videos"
	depends on PACKAGE_powerkey

config TPLAYER_POWERKEY_MONITOR
	depends on !PACKAGE_powerkey
	default n
	bool "Support scanning power key for suspend"
	help
		if suspend while playing multiple-videos, there's a chance that thread will be stuck by mutex-lock. You can scan the power key to control the players' states for avoiding mutex conflict.

config TPLAYER_SUSPEND_TEST
	default n
	bool "tplayerdemo suspend test"
	help
		input "start suspend" to start the mode of testing suspend while playing multi videos. input "stop suspend" to end it.
endmenu
```
