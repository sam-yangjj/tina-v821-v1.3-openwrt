## package/allwinner/vision/libAWIspApi/machinfo/v821/Config.in
```kconfig
menu "Select libisp configuration options"
depends on PACKAGE_libAWIspApi

choice
	prompt "Select compile libisp to static or dynamic library"
	depends on PACKAGE_libAWIspApi
	default libisp_compile_static_lib

config libisp_compile_static_lib
	bool "compile static lib"
	help
	  compile static libs for libisp.

config libisp_compile_dynamic_lib
	bool "compile dynamic lib"
	help
	  compile dynamic lib for libisp.

endchoice

config libisp_build_libispapi
	bool "libisp build and install libawispapi for 3rd apps"
	depends on PACKAGE_libAWIspApi
	default n
	help
	  libisp build and install libawispapi for 3rd apps

config libisp_build_tunning_app
	bool "libisp build awTuningApps (will not install to firmware)"
	depends on PACKAGE_libAWIspApi
	default n
	help
	  libisp build awTuningApp

config libisp_support_fastboot
	bool "libisp support fastboot"
	depends on PACKAGE_libAWIspApi
	default n
	help
	  libisp support fastboot.

config libisp_software_tdm
	bool "libisp support software tdm"
	depends on PACKAGE_libAWIspApi
	default n
	help
	  libisp support software tdm

config libisp_enable_systrace
	bool "libisp enable systrace"
	depends on PACKAGE_libAWIspApi
	default n
	help
	  libisp enable systrace

config libisp_select_sensor
	bool "Select ISP Sensor Tuning Config"
	depends on PACKAGE_libAWIspApi
	default y
	help
	  tell eyesee-mpp-middleware the used sensor type.
	  multiple sensors can be selected in multiple mipi scenarios.

config gc1084
	bool "use sensor gc1084"
	depends on libisp_select_sensor
	default n
	help
	  gc1084 is for ipc.

config imx258
	bool "use sensor imx258"
	depends on libisp_select_sensor
	default n
	help
	  imx258 is for ipc.

config gc2053
	bool "use sensor gc2053"
	depends on libisp_select_sensor
	default y
	help
	  gc2053 is for ipc.

config gc2083
	bool "use sensor gc2083"
	depends on libisp_select_sensor
	default n
	help
	  gc2083 is for ipc.

config gc4663
	bool "use sensor gc4663"
	depends on libisp_select_sensor
	default n
	help
	  gc4663 is for ipc.

config f37p
	bool "use sensor f37p"
	depends on libisp_select_sensor
	default n
	help
	  f37p is for ipc.

config sc2336
	bool "use sensor sc2336"
	depends on libisp_select_sensor
	default n
	help
	  sc2336 is for ipc.

config sp1405
	bool "use sensor sp1405"
	depends on libisp_select_sensor
	default n
	help
	  sp1405 is for ipc.

config sc3336
	bool "use sensor sc3336"
	depends on libisp_select_sensor
	default n
	help
	  sc3336 is for ipc.

config sc1346
	bool "use sensor sc1346"
	depends on libisp_select_sensor
	default n
	help
	  sc1346 is for ipc.

config sc200ai
	bool "use sensor sc200ai"
	depends on libisp_select_sensor
	default n
	help
	  sc200ai is for ipc.

config os02g10
	bool "use sensor os02g10"
	depends on libisp_select_sensor
	default n
	help
	  os02g10 is for ipc.

config bf2257cs
	bool "use sensor bf2257cs"
	depends on libisp_select_sensor
	default n
	help
	  bf2257cs is for ipc.

endmenu
```

## package/allwinner/wireless/wifimanager/Config.in
```kconfig
menu "Wifimanager-v2.0 Configuration"
	depends on (PACKAGE_wifimanager-v2.0 || COMPONENTS_WIFIMANAGER)

choice
	prompt "Wifimanager support platform"
	default WMG_PLATFORM_LINUX
config WMG_PLATFORM_LINUX
	bool "LINUX PLATFORM OS"
config WMG_PLATFORM_FREERTOS
	bool "FREERTOS PLATFORM OS"
config WMG_PLATFORM_XRLINK
	bool "XRLINK PLATFORM OS"
endchoice

menu "Wifimanager support mode Configuration"
config WMG_SUPPORT_STA_MODE
	bool "Wifimanager support sta mode enable"
	depends on (PACKAGE_wifimanager-v2.0 || COMPONENTS_WIFIMANAGER)
	default y
		help
			Wifimanager support sta mode.

config WMG_SUPPORT_AP_MODE
	bool "Wifimanager support ap mode enable"
	depends on (PACKAGE_wifimanager-v2.0 || COMPONENTS_WIFIMANAGER)
	default y
		help
			Wifimanager support ap mode.

config WMG_SUPPORT_MONITOR_MODE
	bool "Wifimanager support monitor mode enable"
	depends on (PACKAGE_wifimanager-v2.0 || COMPONENTS_WIFIMANAGER)
	default n
		help
			Wifimanager support monitor mode.

config WMG_SUPPORT_P2P_MODE
	bool "Wifimanager support p2p mode enable"
	depends on (PACKAGE_wifimanager-v2.0 || COMPONENTS_WIFIMANAGER)
	default n
		help
			Wifimanager support p2p mode.

config WMG_SUPPORT_STA_AP_MODE
	bool "Wifimanager support sta + ap coexist mode enable"
	depends on (PACKAGE_wifimanager-v2.0 || COMPONENTS_WIFIMANAGER) && (WMG_PLATFORM_LINUX || WMG_PLATFORM_XRLINK) && WMG_SUPPORT_STA_MODE && WMG_SUPPORT_AP_MODE
	default n
		help
			Wifimanager support sta + ap coexist mode(You need to make sure your mode supports this mode).

config WMG_SUPPORT_STA_P2P_MODE
	bool "Wifimanager support sta + p2p coexist mode enable"
	depends on (PACKAGE_wifimanager-v2.0 || COMPONENTS_WIFIMANAGER) && WMG_PLATFORM_LINUX && WMG_SUPPORT_STA_MODE && WMG_SUPPORT_P2P_MODE
	default n
		help
			Wifimanager support sta + p2p coexist mode(You need to make sure your mode supports this mode).
endmenu

menu "Wifimanager support protocol Configuration"
config WMG_PROTOCOL_BLE
	bool "CONFIG_WMG_PROTOCOL_BLE"
	depends on ((PACKAGE_wifimanager-v2.0 || COMPONENTS_WIFIMANAGER) && (WMG_PLATFORM_LINUX || WMG_PLATFORM_XRLINK))
	default n
	help
		ble net config.

config WMG_PROTOCOL_JL6328
	bool "CONFIG_WMG_PROTOCOL_JL6328"
	depends on ((PACKAGE_wifimanager-v2.0 || COMPONENTS_WIFIMANAGER) && (WMG_PLATFORM_LINUX || WMG_PLATFORM_XRLINK))
	default n
	help
		JL6328 ble net config.

config WMG_PROTOCOL_XCONFIG
	bool "CONFIG_WMG_PROTOCOL_XCONFIG"
	depends on ((PACKAGE_wifimanager-v2.0 || COMPONENTS_WIFIMANAGER) && (WMG_PLATFORM_LINUX || WMG_PLATFORM_XRLINK))
	default n
	help
		xconfig net config.

config WMG_PROTOCOL_SOUNDWAVE
	bool "CONFIG_WMG_PROTOCOL_SOUNDWAVE"
	depends on ((PACKAGE_wifimanager-v2.0 || COMPONENTS_WIFIMANAGER) && (WMG_PLATFORM_LINUX || WMG_PLATFORM_XRLINK))
	select PACKAGE_alsa-utils
	default n
	help
		soundwave net config.

config WMG_PROTOCOL_QRCODE
	bool "CONFIG_WMG_PROTOCOL_QRCODE"
	depends on ((PACKAGE_wifimanager-v2.0 || COMPONENTS_WIFIMANAGER) && (WMG_PLATFORM_LINUX || WMG_PLATFORM_XRLINK))
	select libcedarc_vdec
	select mpp_vdec
	select mpp_muxer
	select mpp_sample_configfileparser
	default n
	help
		qrcode net config.

config WMG_PROTOCOL_SOFTAP
	bool "CONFIG_WMG_PROTOCOL_SOFTAP"
	depends on ((PACKAGE_wifimanager-v2.0 || COMPONENTS_WIFIMANAGER) && (WMG_PLATFORM_LINUX || WMG_PLATFORM_XRLINK))
	default n
	help
		softap net config.
endmenu

config WMG_CONFIG_PATH
	string "Wifimanager config file path"
	depends on ((PACKAGE_wifimanager-v2.0 || COMPONENTS_WIFIMANAGER) && (WMG_PLATFORM_LINUX || WMG_PLATFORM_XRLINK))
	default "/etc/wifi"
		help
			Wifimanager config file path(default "/etc/wifi").

config WMG_UNREGISTER_CB
	bool "Wifimanager unregister callback function"
	depends on (PACKAGE_wifimanager-v2.0 || COMPONENTS_WIFIMANAGER)
	default y
		help
			Wifimanager unregister callback function.

config WMG_SUPPORT_EXPAND
	bool "Wifimanager support send expand cmd"
	depends on (PACKAGE_wifimanager-v2.0 || COMPONENTS_WIFIMANAGER)
	default n
		help
			Wifimanager support send expand cmd.

choice
	prompt "Wifimanager set default debug level"
	default WMG_DEFAULT_DEBUG_LV_INFO
config WMG_DEFAULT_DEBUG_LV_ERROR
	bool "default debug level: error"
config WMG_DEFAULT_DEBUG_LV_WARN
	bool "default debug level: to warn"
config WMG_DEFAULT_DEBUG_LV_INFO
	bool "default debug level: to info"
config WMG_DEFAULT_DEBUG_LV_DEBUG
	bool "default debug level: to debug"
config WMG_DEFAULT_DEBUG_LV_DUMP
	bool "default debug level: to dump"
config WMG_DEFAULT_DEBUG_LV_EXCE
	bool "default debug level: to exce"
endchoice

endmenu
```

## package/feeds/libs/alsa-lib/Config.in
```kconfig
# alsa package config

menu "Configuration"
	depends on PACKAGE_alsa-lib

config ALSA_LIB_EXTRA_resmgr
	bool "Compile to support resmgr"
	default n
	help
	  resmgr -

config ALSA_LIB_EXTRA_aload
	bool "Support reading /dev/aload*"
	default n
	help
	  aload -

config ALSA_LIB_EXTRA_mixer
	bool "Enable the mixer component"
	default y
	help
	  mixer -

config ALSA_LIB_EXTRA_pcm
	bool "Enable the pcm component"
	default y
	help
	  pcm -

choice
    prompt "compile pcm plugins"
        depends on ALSA_LIB_EXTRA_pcm
        default compile-all-pcm-plugins
        help
            choose compile pcm plugins
        config compile-all-pcm-plugins
            bool "all"
        config custom-pcm-plugins
            bool "custom"
endchoice
menu "Select PCM Plugins"
    depends on custom-pcm-plugins
    config ALSA_LIB_PCM_PLUGIN_copy
        bool "Enable the pcm plugin copy"
        default y
        help
          pcm plugin copy
    config ALSA_LIB_PCM_PLUGIN_linear
        bool "Enable the pcm plugin linear"
        default y
        help
          pcm plugin linear
    config ALSA_LIB_PCM_PLUGIN_route
        bool "Enable the pcm plugin route"
        default y
        help
          pcm plugin route
    config ALSA_LIB_PCM_PLUGIN_mulaw
        bool "Enable the pcm plugin mulaw"
        default y
        help
          pcm plugin mulaw
    config ALSA_LIB_PCM_PLUGIN_alaw
        bool "Enable the pcm plugin alaw"
        default y
        help
          pcm plugin alaw
    config ALSA_LIB_PCM_PLUGIN_adpcm
        bool "Enable the pcm plugin adpcm"
        default y
        help
          pcm plugin adpcm
    config ALSA_LIB_PCM_PLUGIN_rate
        bool "Enable the pcm plugin rate"
        default y
        help
          pcm plugin rate
    config ALSA_LIB_PCM_PLUGIN_plug
        bool "Enable the pcm plugin plug"
        default y
        help
          pcm plugin plug
    config ALSA_LIB_PCM_PLUGIN_multi
        bool "Enable the pcm plugin multi"
        default y
        help
          pcm plugin multi
    config ALSA_LIB_PCM_PLUGIN_shm
        bool "Enable the pcm plugin shm"
        default y
        help
          pcm plugin shm
    config ALSA_LIB_PCM_PLUGIN_file
        bool "Enable the pcm plugin file"
        default y
        help
          pcm plugin file
    config ALSA_LIB_PCM_PLUGIN_null
        bool "Enable the pcm plugin null"
        default y
        help
          pcm plugin null
    config ALSA_LIB_PCM_PLUGIN_empty
        bool "Enable the pcm plugin empty"
        default y
        help
          pcm plugin empty
    config ALSA_LIB_PCM_PLUGIN_share
        bool "Enable the pcm plugin share"
        default y
        help
          pcm plugin share
    config ALSA_LIB_PCM_PLUGIN_meter
        bool "Enable the pcm plugin meter"
        default y
        help
          pcm plugin meter
    config ALSA_LIB_PCM_PLUGIN_hooks
        bool "Enable the pcm plugin hooks"
        default y
        help
          pcm plugin hooks
    config ALSA_LIB_PCM_PLUGIN_lfloat
        bool "Enable the pcm plugin lfloat"
        default y
        help
          pcm plugin lfloat
    config ALSA_LIB_PCM_PLUGIN_ladspa
        bool "Enable the pcm plugin ladspa"
        default y
        help
          pcm plugin ladspa
    config ALSA_LIB_PCM_PLUGIN_dmix
        bool "Enable the pcm plugin dmix"
        default y
        help
          pcm plugin dmix
    config ALSA_LIB_PCM_PLUGIN_dshare
        bool "Enable the pcm plugin dshare"
        default y
        help
          pcm plugin dshare
    config ALSA_LIB_PCM_PLUGIN_dsnoop
        bool "Enable the pcm plugin dsnoop"
        default y
        help
          pcm plugin dsnoop
    config ALSA_LIB_PCM_PLUGIN_asym
        bool "Enable the pcm plugin asym"
        default y
        help
          pcm plugin asym
    config ALSA_LIB_PCM_PLUGIN_iec958
        bool "Enable the pcm plugin iec958"
        default y
        help
          pcm plugin iec958
    config ALSA_LIB_PCM_PLUGIN_softvol
        bool "Enable the pcm plugin softvol"
        default y
        help
          pcm plugin softvol
    config ALSA_LIB_PCM_PLUGIN_extplug
        bool "Enable the pcm plugin extplug"
        default y
        help
          pcm plugin extplug
    config ALSA_LIB_PCM_PLUGIN_ioplug
        bool "Enable the pcm plugin ioplug"
        default y
        help
          pcm plugin ioplug
    config ALSA_LIB_PCM_PLUGIN_mmap_emul
        bool "Enable the pcm plugin mmap_emul"
        default y
        help
          pcm plugin mmap_emul
endmenu

config ALSA_LIB_EXTRA_rawmidi
	bool "Enable the raw MIDI component"
	default n
	help
	 rawmidi -

config ALSA_LIB_EXTRA_hwdep
	bool "Enable the hwdep component"
	default n
	help
	  hwdep -

config ALSA_LIB_EXTRA_seq
	bool "Enable the sequencer component"
	default n
	help
	  seq -

config ALSA_LIB_EXTRA_ucm
	bool "Support use-case-manager component"
	default n
	help
	  ucm -

config ALSA_LIB_EXTRA_topology
	bool "Enable the DSP topology component"
	default n
	help
	  topology -

config ALSA_LIB_EXTRA_alisp
	bool "Enable the alisp component"
	default n
	help
	  alisp -

endmenu
```

## package/feeds/libs/expat/Config.in
```kconfig
menu "libexpat Configuration"
	depends on PACKAGE_libexpat

choice
	prompt "libexpat build lib"
	default LIBEXPAT_BUILD_BOTH
config LIBEXPAT_DYNAMIC_ONLY
	bool "only libexpat dynamic library"
config LIBEXPAT_STATIC_ONLY
	bool "only libexpat static library"
config LIBEXPAT_BUILD_BOTH
	bool "both"
endchoice

endmenu
```

## package/feeds/libs/libdrm/Config.in
```kconfig
menu "libdrm Configuration"
	depends on PACKAGE_libdrm

choice
	prompt "libdrm build lib"
	default LIBDRM_BUILD_BOTH
config LIBDRM_DYNAMIC_ONLY
	bool "only libdrm dynamic library"
config LIBDRM_STATIC_ONLY
	bool "only libdrm static library"
config LIBDRM_BUILD_BOTH
	bool "both"
endchoice

endmenu
```

## package/feeds/utils/glmark2/Config.in
```kconfig
if PACKAGE_glmark2
config GLMARK2_FBDEV
    bool "Enabel fbdev support"
    default y

config GLMARK2_WAYLAND
    depends on PACKAGE_wayland
    bool "Enabel wayland support"
    default n
endif
```

## package/thirdparty/multimedia/tuyaos-ipc/src/tuyaos_adapter/src/bsp_cryptfs/Config.in
```kconfig
menuconfig TUYA_PACKAGE_BSP_CRYPTFS
	bool "BSP cryptfs tools"
	help
	  tuya BSP cryptfs tools.

if TUYA_PACKAGE_BSP_CRYPTFS

config TUYA_PACKAGE_BSP_CRYPTFS_KEY
	string "crypt key (32-bytes ASCII string)"
	default ""
	help
	  Select which config to use.

endif
```
