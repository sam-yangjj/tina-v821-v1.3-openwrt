## openwrt/package/libs/libunwind/Config.in
```kconfig
menu "libunwind Configuration"
	depends on PACKAGE_libunwind

choice
	prompt "libunwind build lib"
	default LIBUNWIND_BUILD_BOTH
config LIBUNWIND_DYNAMIC_ONLY
	bool "only libunwind dynamic library"
config LIBUNWIND_STATIC_ONLY
	bool "only libunwind static library"
config LIBUNWIND_BUILD_BOTH
	bool "both"
endchoice

config LIBUNWIND_COREDUMP
	bool "build libunwind-coredump library"
	default n

config LIBUNWIND_PTRACE
	bool "build libunwind-ptrace library"
	default n

config LIBUNWIND_NTO
	bool "build libunwind-nto library"
	default n

config LIBUNWIND_SETJMP
	bool "build libunwind-setjmp library"
	default n

config LIBUNWIND_HANDLE_CPP_EXCEPTIONS
	bool "use libunwind to handle C++ exceptions"
	default n

endmenu
```

## openwrt/toolchain/glibc/Config.in
```kconfig
choice
	prompt "Glibc version" if TOOLCHAINOPTS
	depends on USE_GLIBC
	default GLIBC_USE_VERSION_2_33
	help
	  Select the C library implementation.

	config GLIBC_USE_VERSION_2_33
		bool "2.33"

	config GLIBC_USE_VERSION_2_37
		bool "2.37"

endchoice
```

## package/allwinner/audio/AudioSystem/Config.in
```kconfig
menu "Select AudioSystem configuration options"
	depends on PACKAGE_AudioSystem

config COMPONENTS_AW_AUDIO_SYSTEM_HW
	bool "Audio HW Support"
	select COMPONENTS_AW_AUDIO_SYSTEM_HW_AMP if AMP_AUDIO_PB_API_ALIAS
	select COMPONENTS_AW_AUDIO_SYSTEM_HW_AMP if AMP_AUDIO_CAP_API_ALIAS
	default y

config COMPONENTS_AW_AUDIO_SYSTEM_HW_PCM
	bool "Audio HW Support PCM"
	depends on COMPONENTS_AW_AUDIO_SYSTEM_HW
	default y

config COMPONENTS_AW_AUDIO_SYSTEM_HW_MULTI_PCM
	bool "Audio HW Support Multi PCM"
	depends on COMPONENTS_AW_AUDIO_SYSTEM_HW_PCM
	default y

config COMPONENTS_AW_AUDIO_SYSTEM_HW_AMP
	bool "Audio HW Support AMP"
	depends on COMPONENTS_AW_AUDIO_SYSTEM_HW
	depends on AMP_AUDIO_PB_API_ALIAS || AMP_AUDIO_CAP_API_ALIAS
	default n

config COMPONENTS_AW_AUDIO_SYSTEM_HW_BT
	bool "Audio HW Support BT"
	depends on COMPONENTS_AW_AUDIO_SYSTEM_HW
	select A2DP_USE_AUDIO_SYSTEM
	select COMPONENTS_RINGBUFFER
	default n

config COMPONENTS_AW_AUDIO_SYSTEM_HW_USB
	bool "Audio HW Support USB"
	depends on COMPONENTS_AW_AUDIO_SYSTEM_HW
	default n

config COMPONENTS_AW_AUDIO_SYSTEM_HW_EQ
	bool "Audio HW Support EQ"
	depends on COMPONENTS_AW_AUDIO_SYSTEM_HW
	depends on SND_COMMON_SUNXI_ALG_CFG
	default n

config COMPONENTS_AW_AUDIO_SYSTEM_HW_AW_EQ
	bool "Audio HW Support AW EQ"
	depends on COMPONENTS_AW_AUDIO_SYSTEM_HW
	depends on COMPONENTS_PROCESS_EQ
	default n

config COMPONENTS_AW_AUDIO_SYSTEM_HW_DRC
	bool "Audio HW Support DRC"
	depends on COMPONENTS_AW_AUDIO_SYSTEM_HW
	depends on SND_COMMON_SUNXI_ALG_CFG
	default n

config COMPONENTS_AW_AUDIO_SYSTEM_TRACK
	bool "Audio Track Support"
	depends on COMPONENTS_AW_AUDIO_SYSTEM_HW
	depends on !AMP_AUDIO_PB_API_UNIQUE
	default y

config COMPONENTS_AW_AUDIO_SYSTEM_RECORD
	bool "Audio Record Support"
	depends on COMPONENTS_AW_AUDIO_SYSTEM_HW
	depends on !AMP_AUDIO_CAP_API_UNIQUE
	default y

config COMPONENTS_AW_AUDIO_SYSTEM_UTILS
	bool "Audio System Utils"
	depends on (AMP_AUDIO_PB_API_UNIQUE && AMP_AUDIO_CAP_API_UNIQUE) || (COMPONENTS_AW_AUDIO_SYSTEM_TRACK && COMPONENTS_AW_AUDIO_SYSTEM_RECORD)
	default y

config COMPONENTS_AW_AUDIO_SYSTEM_UTILS_LOOP
	bool "Audio System loopback utils"
	depends on COMPONENTS_AW_AUDIO_SYSTEM_UTILS
	default n

config COMPONENTS_AW_AUDIO_SYSTEM_UTILS_LOOP_AEC
	bool "loopback utils support aec"
	depends on COMPONENTS_AW_AUDIO_SYSTEM_UTILS_LOOP
	depends on COMPONENTS_PROCESS_AEC
	default n

config COMPONENTS_AW_AUDIO_SYSTEM_PLUGIN
	bool "Audio Plugin Support"
	default y

config COMPONENTS_AW_AUDIO_SYSTEM_PLUGIN_BIT_CONVERT
	bool "Audio Plugin Support bit convert"
	depends on COMPONENTS_AW_AUDIO_SYSTEM_PLUGIN
	default y

config COMPONENTS_AW_AUDIO_SYSTEM_PLUGIN_CHANNEL_MAP
	bool "Audio Plugin Support channel map"
	depends on COMPONENTS_AW_AUDIO_SYSTEM_PLUGIN
	default y

config COMPONENTS_AW_AUDIO_SYSTEM_PLUGIN_RATE
	bool "Audio Plugin Support resample"
	depends on COMPONENTS_AW_AUDIO_SYSTEM_PLUGIN
	default y

config COMPONENTS_AW_AUDIO_SYSTEM_PLUGIN_SOFT_VOLUME
	bool "Audio Plugin Support Soft volume"
	depends on COMPONENTS_AW_AUDIO_SYSTEM_PLUGIN
	default y

config COMPONENTS_AW_AUDIO_SYSTEM_PLUGIN_RESAMPLE_ADJUST
	bool "Audio Plugin resample adjust"
	depends on (COMPONENTS_AW_AUDIO_SYSTEM_PLUGIN && COMPONENTS_AW_AUDIO_SYSTEM_PLUGIN_RATE)
	default n

config COMPONENTS_AW_AUDIO_SYSTEM_PLUGIN_MIXER_CONTROL
	bool "Audio Plugin Support mixer control"
	depends on COMPONENTS_AW_AUDIO_SYSTEM_PLUGIN
	default y

config COMPONENTS_AW_AUDIO_SYSTEM_PRASE_CONFIG_PARAMS
	bool "Audio System Parse config params"
	depends on (COMPONENTS_AW_AUDIO_SYSTEM_HW && COMPONENTS_AW_AUDIO_SYSTEM_PLUGIN)
	default y

endmenu
```

## package/allwinner/audio/audio-process/Config.in
```kconfig
if PACKAGE_audio-process-common-lib
choice
prompt "Choose sunxi audio driver version"
	default AUDIO_PROCESS_SUNXI_AUDIO_ONE
	help
	Select the sunxi audio driver version for audio process.
	There's difference between version 1 and version 2 such as controls and sound devices.

config AUDIO_PROCESS_SUNXI_AUDIO_ONE
	bool "Audio Driver V1"
config AUDIO_PROCESS_SUNXI_AUDIO_TWO
	bool "Audio Driver V2"
endchoice

endif
```

## package/allwinner/common/libawion/machinfo/default/Config.in
```kconfig
if PACKAGE_libawion

choice
prompt "choose ion alloc method"
    default AW_ION_ALLOC_IOMMU
    help
      select default physical memory type to apply
config AW_ION_ALLOC_IOMMU
    bool "aw_ion_alloc_iommu"
config AW_ION_ALLOC_CMA
    bool "aw_ion_alloc_cma"
endchoice

endif
```

## package/allwinner/common/libawion/machinfo/v861/Config.in
```kconfig
if PACKAGE_libawion

choice
prompt "choose ion alloc method"
    default AW_ION_ALLOC_POOL
    help
      select default physical memory type to apply
config AW_ION_ALLOC_CMA
    bool "aw_ion_alloc_cma"
config AW_ION_ALLOC_POOL
    bool "aw_ion_alloc_pool"
endchoice

endif
```

## package/allwinner/common/libglogCWrapper/Config.in
```kconfig
config PACKAGE_libglogCWrapper_config
	bool "libglogCWrapper config"
	default y
	select PACKAGE_libglogCWrapper
	help
	  move config out of PACKAGE_libglogCWrapper to solve recursive dependency.

if PACKAGE_libglogCWrapper_config

choice
	prompt "select log tool"
	default glogCWrapper_use_glog
config glogCWrapper_use_glog
	bool "use glog"
	help
	  use glog API to implement.
config glogCWrapper_use_printf
	bool "use printf"
	help
	  use printf() to implement.
endchoice

endif
```

## package/allwinner/common/parallel_insmod/Config.in
```kconfig
config PARALLEL_INSMOD_EARLY_MODS
    string "early install kernel module"
    depends on PACKAGE_parallel_insmod
    help
      if Y it will generate mods.early.deps
      file to record module dependences.
      spill with space.
      e.g. g2d_sunxi aic8800_fdrv

config NUMBER_THREADS
    int "number of thread to insmod"
    default 4
    depends on PACKAGE_parallel_insmod
    help
      number of thread to insmod
```

## package/allwinner/display/libuapi/Config.in
```kconfig
config PACKAGE_libuapi_config
	bool "libuapi config"
	default n
	select PACKAGE_libuapi
	help
	  move config out of PACKAGE_libuapi to solve recursive dependency.

if PACKAGE_libuapi_config

choice
prompt "Choose display framework"
	default SUNXI_DISPLAY_TWO
	help
	Select the preferred minigui running mode.
config SUNXI_DISPLAY_ONE
	bool "sunxi_display1"
config SUNXI_DISPLAY_TWO
	bool "sunxi_display2"
config SUNXI_DRM
	bool "sunxi_drm"
config SUNXI_DRMCOMPOSITOR
	bool "sunxi_drmcompositor"
endchoice
choice
prompt "Choose transmit display buffer method"
	default SUNXI_TRANS_DISPBUF_FD
	help
	Select how to transmit display buffer to display driver.
config SUNXI_TRANS_DISPBUF_FD
	bool "sunxi_trans_dispbuf_fd"
config SUNXI_TRANS_DISPBUF_PHYADDR
	bool "sunxi_trans_dispbuf_phyaddr"
endchoice
choice
prompt "Choose layer alloc method"
	default LUAPI_LAYER_ALLOC_CHN
	help
	Select how to apply for layer.
config LUAPI_LAYER_ALLOC_CHN
	bool "luapi_layer_alloc_chn"
config LUAPI_LAYER_ALLOC_LAY
	bool "luapi_layer_alloc_lay"
endchoice
choice
prompt "Choose display rendering mode"
	default SUNXI_DISPLAY_DE
	help
		Choose display rendering mode, DE or GPU.
config SUNXI_DISPLAY_DE
	bool "DE"
config SUNXI_DISPLAY_GPU
	bool "GPU"
	help
	Define the macro SUNXI_DISPLAY_GPU, use GPU rendering, send the RGBA data
	after rendering to fb1 display, execute export FRAMEBUFFER=/dev/fb1
	before executing the program, no longer support DispSetEnable, DispSetSrcRect,
	DispSetZorder and DispSetIoctl functions.

	Define the macro SUNXI_DISPLAY_GPU and SUNXI_DISPLAY_GPU_BUF, use GPU rendering,
	send the RGBA data after rendering to layer. No longer support DispSetSrcRect functions.
	Default use.
endchoice

config SUPPORT_CONFIG_FILE
	bool "support config file"

endif
```

## package/allwinner/eyesee-apps/mpp_keyword_spotting_test/config/Config.in
```kconfig
if PACKAGE_mpp_keyword_spotting_test

config COPY_KWS_TEST_TO_ROOTFS
	bool "Copy kws_test binary to rootfs"
	default y
	help
	  This will install the kws_test binary to /bin directory in the root filesystem.

endif
```

## package/allwinner/eyesee-mpp/dragonboard/Config.in
```kconfig
if PACKAGE_eyesee-mpp-dragonboard

config dragonboard_feature_startup
	bool "run automatically at startup in tina"
	default y
	help
	  run automatically at startup in tina.
endif
```
